## target/linux/mediatek/files-6.18/drivers/misc/mediatek/Kconfig
```kconfig
menu "MediaTek vendor modem drivers"

source "drivers/misc/mediatek/ccci_util/Kconfig"
source "drivers/misc/mediatek/eccci/Kconfig"
source "drivers/misc/mediatek/ccmni/Kconfig"
source "drivers/misc/mediatek/hsapif/Kconfig"
source "drivers/misc/mediatek/medmcu/Kconfig"

endmenu

# AIR6 persistent modem Kconfig
source "drivers/misc/mediatek/Kconfig.mt6990"
```
